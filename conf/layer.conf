## conf/layer.conf
```bitbake
# We have a conf and classes directory, add to BBPATH
BBPATH .= ":${LAYERDIR}"

# We have a packages directory, add to BBFILES
BBFILES += "${LAYERDIR}/recipes-*/*/*.bb ${LAYERDIR}/recipes-*/*/*.bbappend"

BBFILE_COLLECTIONS += "cubox"
BBFILE_PATTERN_cubox := "^${LAYERDIR}/"
BBFILE_PRIORITY_cubox = "6"
```

## conf/machine/cubox.conf
```bitbake
#@TYPE: Machine
#@NAME: CuBox machine
#@DESCRIPTION: Machine configuration for the http://www.solid-run.com/products/cubox


IMAGE_FSTYPES ?= "tar.bz2"


require include/tune-marvell-pj4.inc


XSERVER = " \
	xserver-xorg \
	xf86-input-evdev \
	xf86-input-mouse \
	xf86-input-keyboard \
	xf86-video-dove \
	xserver-xorg-extension-extmod \
"
# extmod is necessary for the XVideo extension


PREFERRED_PROVIDER_virtual/egl_cubox ?= "marvell-libgfx"
PREFERRED_PROVIDER_virtual/libgles1_cubox ?= "marvell-libgfx"
PREFERRED_PROVIDER_virtual/libgles2_cubox ?= "marvell-libgfx"
# TODO: does virtual/openvg exist?
PREFERRED_PROVIDER_virtual/openvg_cubox ?= "marvell-libgfx"


KERNEL_IMAGETYPE = "uImage"
PREFERRED_PROVIDER_virtual/kernel_cubox = "linux-cubox"

MACHINE_FEATURES = "kernel26 serial ethernet"


SERIAL_CONSOLE = "115200 ttyS0"
```

## conf/machine/include/tune-marvell-pj4.inc
```bitbake
DEFAULTTUNE ?= "marvellpj4"

require conf/machine/include/arm/arch-armv7a.inc

TUNEVALID[marvellpj4] = "Enable Marvell PJ4 specific processor optimizations"
TUNE_CCARGS += "${@bb.utils.contains("TUNE_FEATURES", "marvellpj4", "-mfpu=vfpv3-d16 -mtune=marvell-pj4", "", d)}"

AVAILTUNES += "marvellpj4"
ARMPKGARCH_tune-marvellpj4 ?= "marvellpj4"
TUNE_FEATURES_tune-marvellpj4 ?= "${TUNE_FEATURES_tune-armv7a} marvellpj4"
PACKAGE_EXTRA_ARCHS_tune-marvellpj4 = "${PACKAGE_EXTRA_ARCHS_tune-armv7a} marvellpj4 marvellpj4-vfp"

AVAILTUNES += "marvellpj4hf"
ARMPKGARCH_tune-marvellpj4hf ?= "marvellpj4"
TUNE_FEATURES_tune-marvellpj4hf ?= "${TUNE_FEATURES_tune-armv7ahf} marvellpj4"
PACKAGE_EXTRA_ARCHS_tune-marvellpj4hf = "${PACKAGE_EXTRA_ARCHS_tune-armv7ahf} marvellpj4hf-vfp"
```
